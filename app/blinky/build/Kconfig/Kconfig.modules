## app/blinky/build/Kconfig/Kconfig.modules
```kconfig
menu "nrf (/Users/leannanguyen/nrf_devkit/ncs/nrf)"
osource "/Users/leannanguyen/nrf_devkit/ncs/nrf/Kconfig.nrf"
config ZEPHYR_NRF_MODULE
	bool
	default y
endmenu
menu "wfa-qt-control-app (/Users/leannanguyen/nrf_devkit/ncs/modules/lib/wfa-qt-control-app)"
osource "/Users/leannanguyen/nrf_devkit/ncs/modules/lib/wfa-qt-control-app/zephyr/Kconfig"
config ZEPHYR_WFA_QT_CONTROL_APP_MODULE
	bool
	default y
endmenu
menu "mcuboot (/Users/leannanguyen/nrf_devkit/ncs/bootloader/mcuboot)"
osource "$(ZEPHYR_MCUBOOT_KCONFIG)"
config ZEPHYR_MCUBOOT_MODULE
	bool
	default y
endmenu
menu "mbedtls (/Users/leannanguyen/nrf_devkit/ncs/modules/crypto/mbedtls)"
osource "$(ZEPHYR_MBEDTLS_KCONFIG)"
config ZEPHYR_MBEDTLS_MODULE
	bool
	default y
endmenu
menu "trusted-firmware-m (/Users/leannanguyen/nrf_devkit/ncs/modules/tee/tf-m/trusted-firmware-m)"
osource "$(ZEPHYR_TRUSTED_FIRMWARE_M_KCONFIG)"
config ZEPHYR_TRUSTED_FIRMWARE_M_MODULE
	bool
	default y
endmenu
menu "cjson (/Users/leannanguyen/nrf_devkit/ncs/modules/lib/cjson)"
osource "$(ZEPHYR_CJSON_KCONFIG)"
config ZEPHYR_CJSON_MODULE
	bool
	default y
endmenu
menu "azure-sdk-for-c (/Users/leannanguyen/nrf_devkit/ncs/modules/lib/azure-sdk-for-c)"
osource "$(ZEPHYR_AZURE_SDK_FOR_C_KCONFIG)"
config ZEPHYR_AZURE_SDK_FOR_C_MODULE
	bool
	default y
endmenu
menu "cirrus-logic (/Users/leannanguyen/nrf_devkit/ncs/modules/hal/cirrus-logic)"
osource "/Users/leannanguyen/nrf_devkit/ncs/modules/hal/cirrus-logic/Kconfig"
config ZEPHYR_CIRRUS_LOGIC_MODULE
	bool
	default y
endmenu
menu "openthread (/Users/leannanguyen/nrf_devkit/ncs/modules/lib/openthread)"
osource "$(ZEPHYR_OPENTHREAD_KCONFIG)"
config ZEPHYR_OPENTHREAD_MODULE
	bool
	default y
endmenu
menu "memfault-firmware-sdk (/Users/leannanguyen/nrf_devkit/ncs/modules/lib/memfault-firmware-sdk)"
osource "/Users/leannanguyen/nrf_devkit/ncs/modules/lib/memfault-firmware-sdk/ports/zephyr/Kconfig"
config ZEPHYR_MEMFAULT_FIRMWARE_SDK_MODULE
	bool
	default y
endmenu
menu "canopennode (/Users/leannanguyen/nrf_devkit/ncs/modules/lib/canopennode)"
osource "$(ZEPHYR_CANOPENNODE_KCONFIG)"
config ZEPHYR_CANOPENNODE_MODULE
	bool
	default y
endmenu
menu "chre (/Users/leannanguyen/nrf_devkit/ncs/modules/lib/chre)"
osource "/Users/leannanguyen/nrf_devkit/ncs/modules/lib/chre/platform/zephyr/Kconfig"
config ZEPHYR_CHRE_MODULE
	bool
	default y
endmenu
menu "cmsis (/Users/leannanguyen/nrf_devkit/ncs/modules/hal/cmsis)"
osource "$(ZEPHYR_CMSIS_KCONFIG)"
config ZEPHYR_CMSIS_MODULE
	bool
	default y
endmenu
menu "fatfs (/Users/leannanguyen/nrf_devkit/ncs/modules/fs/fatfs)"
osource "$(ZEPHYR_FATFS_KCONFIG)"
config ZEPHYR_FATFS_MODULE
	bool
	default y
endmenu
menu "hal_nordic (/Users/leannanguyen/nrf_devkit/ncs/modules/hal/nordic)"
osource "$(ZEPHYR_HAL_NORDIC_KCONFIG)"
config ZEPHYR_HAL_NORDIC_MODULE
	bool
	default y
endmenu
menu "liblc3 (/Users/leannanguyen/nrf_devkit/ncs/modules/lib/liblc3)"
osource "$(ZEPHYR_LIBLC3_KCONFIG)"
config ZEPHYR_LIBLC3_MODULE
	bool
	default y
endmenu
menu "littlefs (/Users/leannanguyen/nrf_devkit/ncs/modules/fs/littlefs)"
osource "$(ZEPHYR_LITTLEFS_KCONFIG)"
config ZEPHYR_LITTLEFS_MODULE
	bool
	default y
endmenu
menu "loramac-node (/Users/leannanguyen/nrf_devkit/ncs/modules/lib/loramac-node)"
osource "$(ZEPHYR_LORAMAC_NODE_KCONFIG)"
config ZEPHYR_LORAMAC_NODE_MODULE
	bool
	default y
endmenu
menu "lvgl (/Users/leannanguyen/nrf_devkit/ncs/modules/lib/gui/lvgl)"
osource "/Users/leannanguyen/nrf_devkit/ncs/modules/lib/gui/lvgl/Kconfig"
config ZEPHYR_LVGL_MODULE
	bool
	default y
endmenu
menu "lz4 (/Users/leannanguyen/nrf_devkit/ncs/modules/lib/lz4)"
osource "$(ZEPHYR_LZ4_KCONFIG)"
config ZEPHYR_LZ4_MODULE
	bool
	default y
endmenu
menu "nanopb (/Users/leannanguyen/nrf_devkit/ncs/modules/lib/nanopb)"
osource "$(ZEPHYR_NANOPB_KCONFIG)"
config ZEPHYR_NANOPB_MODULE
	bool
	default y
endmenu
menu "picolibc (/Users/leannanguyen/nrf_devkit/ncs/modules/lib/picolibc)"
osource "/Users/leannanguyen/nrf_devkit/ncs/modules/lib/picolibc/zephyr/Kconfig"
config ZEPHYR_PICOLIBC_MODULE
	bool
	default y
endmenu
menu "segger (/Users/leannanguyen/nrf_devkit/ncs/modules/debug/segger)"
osource "$(ZEPHYR_SEGGER_KCONFIG)"
config ZEPHYR_SEGGER_MODULE
	bool
	default y
endmenu
menu "TraceRecorder (/Users/leannanguyen/nrf_devkit/ncs/modules/debug/TraceRecorder)"
osource "/Users/leannanguyen/nrf_devkit/ncs/modules/debug/TraceRecorder/kernelports/Zephyr/Kconfig"
config ZEPHYR_TRACERECORDER_MODULE
	bool
	default y
endmenu
menu "uoscore-uedhoc (/Users/leannanguyen/nrf_devkit/ncs/modules/lib/uoscore-uedhoc)"
osource "$(ZEPHYR_UOSCORE_UEDHOC_KCONFIG)"
config ZEPHYR_UOSCORE_UEDHOC_MODULE
	bool
	default y
endmenu
menu "zcbor (/Users/leannanguyen/nrf_devkit/ncs/modules/lib/zcbor)"
osource "$(ZEPHYR_ZCBOR_KCONFIG)"
config ZEPHYR_ZCBOR_MODULE
	bool
	default y
endmenu
menu "zscilib (/Users/leannanguyen/nrf_devkit/ncs/modules/lib/zscilib)"
osource "/Users/leannanguyen/nrf_devkit/ncs/modules/lib/zscilib/Kconfig.zscilib"
config ZEPHYR_ZSCILIB_MODULE
	bool
	default y
endmenu
menu "nrfxlib (/Users/leannanguyen/nrf_devkit/ncs/nrfxlib)"
osource "/Users/leannanguyen/nrf_devkit/ncs/nrfxlib/Kconfig.nrfxlib"
config ZEPHYR_NRFXLIB_MODULE
	bool
	default y
endmenu
menu "connectedhomeip (/Users/leannanguyen/nrf_devkit/ncs/modules/lib/matter)"
osource "/Users/leannanguyen/nrf_devkit/ncs/modules/lib/matter/config/nrfconnect/chip-module/Kconfig"
config ZEPHYR_CONNECTEDHOMEIP_MODULE
	bool
	default y
endmenu
```

## app/blinky/build/Kconfig/Kconfig.shield.defconfig
```kconfig
osource "/Users/leannanguyen/nrf_devkit/ncs/nrf/boards/shields/*/Kconfig.defconfig"
```

## app/blinky/build/Kconfig/Kconfig.sysbuild.modules
```kconfig
menu "nrf (/Users/leannanguyen/nrf_devkit/ncs/nrf)"
osource "/Users/leannanguyen/nrf_devkit/ncs/nrf/sysbuild/Kconfig.sysbuild"
config ZEPHYR_NRF_MODULE
	bool
	default y
endmenu
```
